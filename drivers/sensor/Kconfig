## drivers/sensor/Kconfig
```kconfig
# Copyright (c) 2024 Espressif Systems (Shanghai) Co., Ltd.
# SPDX-License-Identifier: Apache-2.0

if SENSOR
rsource "icm42670/Kconfig"
endif # SENSOR
```

## west.yml
```yaml
# Copyright (c) 2024 Espressif Systems (Shanghai) Co., Ltd.
# SPDX-License-Identifier: Apache-2.0

manifest:
  self:
    west-commands: scripts/west-commands.yml

  remotes:
    - name: zephyrproject-rtos
      url-base: https://github.com/zephyrproject-rtos

  projects:
    - name: zephyr
      remote: zephyrproject-rtos
      revision: main
      import:
        # By using name-allowlist we can clone only the modules that are
        # strictly needed by the application.
        name-allowlist:
          - hal_espressif      # required by the Espressif port
          - mcuboot            # required if using MCUboot as bootloader
          - mbedtls            # required for crypto and Wi-Fi
          - lvgl               # required by the LVGL library
          - tinycrypt          # required by the TinyCrypt library
```
